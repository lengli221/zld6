#include "includes.h"

static uint8 auchCRCHi[] =
{
    0x00, 0xC1, 0x81, 0x40, 0x01, 0xC0, 0x80, 0x41, 0x01, 0xC0, 0x80, 0x41, 0x00, 0xC1, 0x81,
    0x40, 0x01, 0xC0, 0x80, 0x41, 0x00, 0xC1, 0x81, 0x40, 0x00, 0xC1, 0x81, 0x40, 0x01, 0xC0,
    0x80, 0x41, 0x01, 0xC0, 0x80, 0x41, 0x00, 0xC1, 0x81, 0x40, 0x00, 0xC1, 0x81, 0x40, 0x01,
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    0x00, 0xC1, 0x81, 0x40, 0x01, 0xC0, 0x80, 0x41, 0x01, 0xC0, 0x80, 0x41, 0x00, 0xC1, 0x81,
    0x40
} ;


static char auchCRCLo[] =
{
    0x00, 0xC0, 0xC1, 0x01, 0xC3, 0x03, 0x02, 0xC2, 0xC6, 0x06, 0x07, 0xC7, 0x05, 0xC5, 0xC4,
    0x04, 0xCC, 0x0C, 0x0D, 0xCD, 0x0F, 0xCF, 0xCE, 0x0E, 0x0A, 0xCA, 0xCB, 0x0B, 0xC9, 0x09,
    0x08, 0xC8, 0xD8, 0x18, 0x19, 0xD9, 0x1B, 0xDB, 0xDA, 0x1A, 0x1E, 0xDE, 0xDF, 0x1F, 0xDD,
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    0x44, 0x84, 0x85, 0x45, 0x87, 0x47, 0x46, 0x86, 0x82, 0x42, 0x43, 0x83, 0x41, 0x81, 0x80,
    0x40
} ;

uint16 CRC16(uint8 *puchMsg, uint16 usDataLen)
{
	uint8 uchCRCHi = 0xFF ; 
	uint8 uchCRCLo = 0xFF ; 
	uint8 uIndex ; 
	while (usDataLen--) 
	{
		uIndex = uchCRCHi ^ *puchMsg++ ; 
		uchCRCHi = uchCRCLo ^ auchCRCHi[uIndex] ;
		uchCRCLo = auchCRCLo[uIndex] ;
	}
	return (uchCRCHi << 8 | uchCRCLo) ;
}

uint8 CalcBcc(uint8 *buf,uint16 len)
{
	uint8 sum=0;
	uint8 *tx = buf;
	
	while(len--)
	{
		sum ^=*tx++;
	}
	return(sum);
}

uint8 calcSum(uint8 *buf,uint16 len)
{//和校验
	uint8 sum = 0xA5;
	while(len--)
	{
		sum += *buf++;
	}
	return sum;
}

int32 MSToTicks(uint32 ms)
{
	uint32 ticks = 0; 
	if(ms != 0)
	{
		ticks = (ms * OS_TICKS_PER_SEC)/1000;
		if(ticks < 1)
			ticks = 1;
	}
	return ticks;
}

bool TickOut(uint32 *tick,uint32 timeout)
{
	uint32 icount = 0;

	if(timeout == 0)
	{
		*tick = OSTimeGet();
		return true;
	}
	else
	{
		icount = MSToTicks(timeout);  
		if((OSTimeGet() - *tick) > icount)
			return true;
		else
			return false;
	}
}

void Sleep(uint32 milliSec)
{
	if(milliSec == 0)
	{
		return;
	}
	OSTimeDlyHMSM(0,0,(milliSec/1000),(milliSec%1000)); 
}

void uint16Tou16Ascii(uint16 tmp,uint16 *u16Ascii)
{
	u16Ascii[0] = (((tmp/1000 + '0')<<8)&0xFF00) + (tmp/100%10 + '0');
	u16Ascii[1] = (((tmp/10%10 + '0')<<8)&0xFF00) + (tmp%10 + '0'); 
}

bool Compare_Data(uint8*Src,uint8*Dst,uint16 len)
{
	uint16 i=0;
	bool ret = true;

	for(i=0;i<len;i++)
	{
		if(*Src++ != *Dst++)
		{
			ret = false;
			break;
		}
	}
	return(ret);
}

void  Uint16Reverse(uint16 *buf, uint8 len)
{
	uint8 i;
	for(i = 0; i < len; i++)
	{
		*buf = ((*buf)>>8)+((*buf)<<8);
		buf++;
	}
}

/*
** 交换高低字节
*/
uint16 little_Big_Endian__Exchange(uint16 data){
	return ((uint16)((((data & 0x00FF)<<8)&0xFF00) + (((data&0xFF00)>>8)&0x00FF)));
}

void A_FConvertToAscii(uint8 *tmp)
{
	uint8 tmp0=*tmp;	
	if(tmp0>=0x0A&&tmp0<=0x0F)
	{
		tmp0 = tmp0-0x0A+'A'-'0';
	}
	*tmp = tmp0;
}

void uint32ToAscii(uint32 inint,uint8 point, uint16 *outasc)
{
	uint32 buf;
	uint8 out[20],i;
	memset(out,'0',sizeof(out));
	buf =inint;
	i = 0;
	do
	{
		if((i == point)&&(point != 0))
		{
			i++;
		}
		out[i++] = (buf % 10) + '0';
		buf /= 10;
		if(buf == 0)
		{
			break;
		}

	}while(buf);

	if((i <= point)&&(point > 0))
	{
		i = point+2;
	}
	if(point != 0)
	{
		out[point] ='.';
	}
	
	while(i)
	{
		i--;
		*outasc = out[i]<<8;
		if(i == 0)
		{
			break;
		}
		i--;
		*outasc += out[i];
		if(i == 0)
		{
			break;
		}
		outasc++;
	}
}

static uint8 ConversionAscii(uint8 tmp)
{
	uint8 tmpAscii=0;
	if(tmp>=0x0A&&tmp<=0x0F)
	{
		tmp += 0x37; 
	}
	else
	{
		tmp += '0'; 		
	}
	tmpAscii = tmp;
	return(tmpAscii);
}

void ByteConversionAscii(uint8*src,uint8*dst,uint16 len)
{
	uint8 i=0;
	uint8 tmp = 0;
	uint8 *srcPtr = src;
	uint8 *dstPtr = dst;

	for(i=0;i<len;i++)
	{
		#if Byte_Mode == Byte_Mode_Big
		tmp = (*srcPtr>>4)&0x0F;
		#else
		tmp = *srcPtr&0x0F;
		#endif
		*dstPtr++ = ConversionAscii(tmp);
		#if Byte_Mode == Byte_Mode_Big
		tmp = *srcPtr&0x0F;
		#else
		tmp = (*srcPtr>>4)&0x0F;
		#endif
		*dstPtr++ = ConversionAscii(tmp);
		srcPtr++;
	}
}

void AsciiConversionByte(uint8*src,uint8*dst,uint16 len)
{
	uint8 i=0;
	uint8 *srcPtr = src;
	uint8 *srcPtrBkp = src;

	for(i=0;i<len;i++)
	{
		if((*srcPtr>=0x41)&&(*srcPtr<=0x46))
		{
			*srcPtr -= 0x37;
		}
		else
		{
			*srcPtr -= '0';
		}
		srcPtr++;
	}

	for(i=0;i<(uint16)(len/2);i++)
	{
		#if Byte_Mode == Byte_Mode_Big
		*dst = ((*srcPtrBkp<<4)&0xF0)+(*(srcPtrBkp+1)&0x0F);
		#else
		*dst = ((*(srcPtrBkp+1)<<4)&0xF0)+(*srcPtrBkp&0x0F);
		#endif
		dst++;
		srcPtrBkp += 2; 
	}
}


